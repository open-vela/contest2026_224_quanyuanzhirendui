## board/atk-dnn647/configs/nsh/defconfig
```kconfig
CONFIG_ARCH="arm"
CONFIG_ARCH_ARMV8M=y
CONFIG_ARCH_BOARD="atk-dnn647"
CONFIG_ARCH_BOARD_ATK_DNN647=y
CONFIG_ARCH_CHIP="stm32n6"
CONFIG_ARCH_CHIP_STM32=y
CONFIG_ARCH_CHIP_STM32N647X0=y
CONFIG_ARCH_CHIP_STM32N6=y
CONFIG_ARCH_INTERRUPTSTACK=4096
CONFIG_ARCH_STACKDUMP=y
CONFIG_ARCH_TOOLCHAIN_GCC=y
CONFIG_ARM_TOOLCHAIN_GNU_EABI=y
CONFIG_BOARD_LOOPSPERMSEC=21000
CONFIG_BUILTIN=y
CONFIG_DEBUG_ASSERTIONS=y
CONFIG_DEBUG_FEATURES=y
CONFIG_DEBUG_SYMBOLS=y
CONFIG_FS_LOCK_BUCKET_SIZE=0
CONFIG_FS_MQUEUE_VFS_PATH="/var/mqueue"
CONFIG_FS_NEPOLL_DESCRIPTORS=8
CONFIG_HAVE_CXX=y
CONFIG_HAVE_CXXINITIALIZE=y
CONFIG_IDLETHREAD_STACKSIZE=4096
CONFIG_INIT_ENTRYPOINT="nsh_main"
CONFIG_LIBC_HOMEDIR="/tmp"
CONFIG_LIBC_MAX_EXITFUNS=8
CONFIG_LINE_MAX=64
CONFIG_MM_NODE_GUARDSIZE=0
CONFIG_MQ_MAXMSGSIZE=64
CONFIG_NAME_MAX=32
CONFIG_NCPUS=1
CONFIG_NFILE_DESCRIPTORS_PER_BLOCK=8
CONFIG_NSH_ARCHINIT=y
CONFIG_NSH_BUILTIN_APPS=y
CONFIG_NSH_FILEIOSIZE=512
CONFIG_NSH_READLINE=y
CONFIG_PERCPU_ARRAY=y
CONFIG_PREALLOC_TIMERS=4
CONFIG_RAM_SIZE=4193280
CONFIG_RAM_START=0x34000400
CONFIG_RAW_BINARY=y
CONFIG_READLINE_CMD_HISTORY=y
CONFIG_READLINE_TABCOMPLETION=y
CONFIG_RR_INTERVAL=200
CONFIG_SCHED_WAITPID=y
CONFIG_STACK_COLORATION=y
CONFIG_STACK_USAGE_WARNING=0
CONFIG_START_DAY=1
CONFIG_START_MONTH=1
CONFIG_START_YEAR=2026
CONFIG_STREAM_BASE64_BUFFER_SIZE=64
CONFIG_STREAM_HEXDUMP_BUFFER_SIZE=64
CONFIG_STREAM_OUT_BUFFER_SIZE=64
CONFIG_STM32_USART1=y
CONFIG_SYSTEM_NSH=y
CONFIG_TASK_NAME_SIZE=0
CONFIG_USART1_SERIAL_CONSOLE=y
```
